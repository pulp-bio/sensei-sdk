## NRF/boards/shields/SENSEI_WiFi_SD_Shield_V1/Kconfig.shield
```kconfig
# Copyright (c) 2019 Linaro Limited
# SPDX-License-Identifier: Apache-2.0

config SHIELD_SENSEI_WIFI_SD_SHIELD_V1
	def_bool $(shields_list_contains,SENSEI_WiFi_SD_Shield_V1)
```

## NRF/boards/shields/SENSEI_mmWaveShield/Kconfig.shield
```kconfig
# Copyright (c) 2026 ETH Zurich and University of Bologna
# SPDX-License-Identifier: Apache-2.0

config SHIELD_SENSEI_MMWAVESHIELD
	def_bool $(shields_list_contains,SENSEI_mmWaveShield)
```
